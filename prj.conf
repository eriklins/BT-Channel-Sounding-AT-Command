## CMakeLists.txt
```
cmake_minimum_required(VERSION 3.20.0)

find_package(Zephyr REQUIRED HINTS $ENV{ZEPHYR_BASE})
project(cs_at_command)

FILE(GLOB app_sources src/*.c)
target_sources(app PRIVATE
  ${app_sources}
)
```

## prj.conf
```kconfig
CONFIG_SERIAL=y
CONFIG_UART_INTERRUPT_DRIVEN=y
CONFIG_UART_USE_RUNTIME_CONFIGURE=y

CONFIG_LOG=y
CONFIG_LOG_MODE_DEFERRED=y
CONFIG_LOG_BACKEND_RTT=y
CONFIG_USE_SEGGER_RTT=y
CONFIG_LOG_BACKEND_UART=n

CONFIG_NCS_SAMPLES_DEFAULTS=y

CONFIG_BT=y
CONFIG_BT_SMP=y
CONFIG_BT_CENTRAL=y
CONFIG_BT_PERIPHERAL=y
CONFIG_BT_MAX_CONN=4
CONFIG_BT_GAP_AUTO_UPDATE_CONN_PARAMS=n
CONFIG_BT_BONDABLE=n
CONFIG_BT_DEVICE_NAME="CS AT Command"
CONFIG_BT_DEVICE_NAME_MAX=32
CONFIG_BT_DEVICE_NAME_DYNAMIC=y
CONFIG_BT_MAX_PAIRED=4

# Non-volatile settings storage
CONFIG_SETTINGS=y
CONFIG_SETTINGS_NVS=y
CONFIG_NVS=y
CONFIG_FLASH=y
CONFIG_FLASH_MAP=y
CONFIG_PM_PARTITION_SIZE_SETTINGS_STORAGE=0x2000

CONFIG_BT_GATT_CLIENT=y
CONFIG_BT_GATT_DYNAMIC_DB=y

CONFIG_BT_SCAN=y
CONFIG_BT_SCAN_FILTER_ENABLE=y
CONFIG_BT_SCAN_UUID_CNT=1

CONFIG_BT_CHANNEL_SOUNDING=y
CONFIG_BT_CHANNEL_SOUNDING_REASSEMBLY_BUFFER_CNT=4
CONFIG_BT_RAS=y
CONFIG_BT_RAS_RRSP=y
CONFIG_BT_RAS_RREQ=y

# The Ranging Profile recommends a MTU of at least 247 octets.
CONFIG_BT_L2CAP_TX_MTU=498
CONFIG_BT_BUF_ACL_TX_SIZE=502
CONFIG_BT_BUF_ACL_RX_SIZE=502
CONFIG_BT_ATT_PREPARE_COUNT=3
CONFIG_BT_CTLR_DATA_LENGTH_MAX=251

# No mode 3 -- reduces RAM usage. Max 4 antenna paths supports
# dual-antenna initiators and reflectors
CONFIG_BT_RAS_MODE_3_SUPPORTED=n
CONFIG_BT_RAS_MAX_ANTENNA_PATHS=4
CONFIG_BT_CTLR_SDC_CS_MAX_ANTENNA_PATHS=4
CONFIG_BT_CTLR_SDC_CS_NUM_ANTENNAS=1
CONFIG_BT_CTLR_SDC_CS_STEP_MODE3=n

CONFIG_BT_CTLR_CHANNEL_SOUNDING_TEST=n
CONFIG_BT_TRANSMIT_POWER_CONTROL=y
CONFIG_BT_CTLR_SDC_CS_COUNT=4

CONFIG_FPU=y
CONFIG_FPU_SHARING=y
CONFIG_CBPRINTF_FP_SUPPORT=y
```

## boards/bl54l15u_dvk_dual-antenna_cpuapp.conf
```kconfig
CONFIG_BT_CTLR_SDC_CS_NUM_ANTENNAS=2
```

## boards/bl54l15_dvk_nrf54l15_cpuapp.overlay
```dts
/* Restore full RRAM and SRAM space - by default some parts are dedicated to FLPR */

&cpuapp_rram {
	reg = <0x0 DT_SIZE_K(1524)>;
};

&cpuapp_sram {
	reg = <0x20000000 DT_SIZE_K(256)>;
	ranges = <0x0 0x20000000 0x40000>;
};
```

## boards/bl54l15u_dvk_dual-antenna_cpuapp.overlay
```dts
/*
 * Copyright (c) 2025 Nordic Semiconductor ASA
 *
 * SPDX-License-Identifier: LicenseRef-Nordic-5-Clause
 */

/ {
	cs_antenna_switch: cs-antenna-config {
		status = "okay";
		compatible = "nordic,bt-cs-antenna-switch";
		ant-gpios = <&gpio1 9 (GPIO_ACTIVE_HIGH)>;  // the BL54L15µ dual-antenna addon uses just one gpio in multiplexing mode
		multiplexing-mode = <1>;                    
	};
};

/* Restore full RRAM and SRAM space - by default some parts are dedicated to FLPR */

&cpuapp_rram {
	reg = <0x0 DT_SIZE_K(1524)>;
};

&cpuapp_sram {
	reg = <0x20000000 DT_SIZE_K(256)>;
	ranges = <0x0 0x20000000 0x40000>;
};
```

## src/main.c
```c
#include <string.h>
#include <strings.h>
#include <stdlib.h>
#include <zephyr/kernel.h>
#include <zephyr/logging/log.h>
#include <zephyr/sys/reboot.h>

#include "at_cmd.h"
#include "app_settings.h"
#include "bt_mgr.h"
#include "iq_output.h"
#include "session_mgr.h"
#include "version.h"

LOG_MODULE_REGISTER(main, LOG_LEVEL_INF);

/* --- Autoconnect --- */

static struct k_work_delayable autoconnect_scan_work;
static struct k_work autoconnect_connect_work;
static bool autoconnect_user_stopped;

static void autoconnect_connect_work_fn(struct k_work *work)
{
	const struct autoconnect_cfg *cfg = app_settings_get_autoconnect();

	if (!cfg->enabled || autoconnect_user_stopped) {
		return;
	}

	if (bt_mgr_is_scanning()) {
		bt_mgr_scan_stop();
	}

	bt_addr_le_t addr;
	int err = bt_mgr_scan_lookup(cfg->mac, &addr);

	if (err) {
		LOG_WRN("Autoconnect: lookup failed, retrying");
		k_work_schedule(&autoconnect_scan_work, K_SECONDS(2));
		return;
	}

	uint8_t session_id;

	err = session_mgr_start(&addr, cfg->interval_ms, &session_id);
	if (err) {
		LOG_WRN("Autoconnect: session start failed (err %d), retrying",
			err);
		k_work_schedule(&autoconnect_scan_work, K_SECONDS(5));
		return;
	}

	char resp[16];

	snprintk(resp, sizeof(resp), "+RANGE:%u", session_id);
	at_cmd_respond(resp);
}

static void autoconnect_scan_found_cb(const char *mac_hex)
{
	const struct autoconnect_cfg *cfg = app_settings_get_autoconnect();

	if (!cfg->enabled || autoconnect_user_stopped) {
		return;
	}

	if (strcasecmp(mac_hex, cfg->mac) != 0) {
		return;
	}

	/* Defer connect to system workqueue — not safe from BT callback */
	k_work_submit(&autoconnect_connect_work);
}

static void autoconnect_scan_work_fn(struct k_work *work)
{
	const struct autoconnect_cfg *cfg = app_settings_get_autoconnect();

	if (!cfg->enabled || autoconnect_user_stopped) {
		return;
	}

	if (bt_mgr_get_role() != BT_MGR_ROLE_INITIATOR) {
		return;
	}

	if (session_mgr_has_active()) {
		return;
	}

	int err = bt_mgr_scan_start(0);

	if (err == -EALREADY) {
		/* Scan already running — callback will fire when target appears */
		return;
	}

	if (err) {
		LOG_WRN("Autoconnect: scan start failed (err %d), retrying",
			err);
		k_work_schedule(&autoconnect_scan_work, K_SECONDS(5));
	}
}

static void autoconnect_disconnect_cb(uint8_t session_id)
{
	if (autoconnect_user_stopped) {
		return;
	}

	k_work_schedule(&autoconnect_scan_work, K_SECONDS(2));
}

static void autoconnect_trigger(void)
{
	const struct autoconnect_cfg *cfg = app_settings_get_autoconnect();

	if (!cfg->enabled) {
		return;
	}

	autoconnect_user_stopped = false;
	k_work_schedule(&autoconnect_scan_work, K_MSEC(500));
}

static void at_test_handler(const char *args)
{
	at_cmd_respond("OK");
}

static void ati_handler(const char *args)
{
	while (*args == ' ') {
		args++;
	}

	if (strncasecmp(args, "version", 7) == 0) {
		at_cmd_respond(APP_VERSION);
		at_cmd_respond("OK");
	} else if (strncasecmp(args, "board", 5) == 0) {
		char resp[32];
		snprintk(resp, sizeof(resp), "%s - %d antenna%s",
				CONFIG_BOARD, CONFIG_BT_CTLR_SDC_CS_NUM_ANTENNAS,
				CONFIG_BT_CTLR_SDC_CS_NUM_ANTENNAS>1?"s":"");
		at_cmd_respond(resp);
		at_cmd_respond("OK");
	} else {
		at_cmd_respond("ERROR");
	}
}

static void atz_handler(const char *args)
{
	//at_cmd_respond("OK");
	sys_reboot(SYS_REBOOT_COLD);
}

static void at_scan_handler(const char *args)
{
	while (*args == ' ') {
		args++;
	}

	if (strcasecmp(args, "stop") == 0) {
		int err = bt_mgr_scan_stop();

		at_cmd_respond(err ? "ERROR" : "OK");
		return;
	}

	uint16_t timeout = 0;

	if (*args != '\0') {
		timeout = (uint16_t)atoi(args);
		if (timeout == 0) {
			at_cmd_respond("ERROR");
			return;
		}
	}

	int err = bt_mgr_scan_start(timeout);

	at_cmd_respond(err ? "ERROR" : "OK");
}

static void at_adv_handler(const char *args)
{
	while (*args == ' ') {
		args++;
	}

	if (strcasecmp(args, "start") == 0) {
		int err = bt_mgr_adv_start();

		at_cmd_respond(err ? "ERROR" : "OK");
	} else if (strcasecmp(args, "stop") == 0) {
		int err = bt_mgr_adv_stop();

		at_cmd_respond(err ? "ERROR" : "OK");
	} else {
		at_cmd_respond("ERROR");
	}
}

static void ats_handler(const char *args)
{
	while (*args == ' ') {
		args++;
	}

	/* ATS role=? or ATS role=<value> */
	if (strncasecmp(args, "role", 4) == 0) {
		const char *val = args + 4;

		if (*val != '=') {
			at_cmd_respond("ERROR");
			return;
		}
		val++;

		if (*val == '?') {
			at_cmd_respond(app_settings_get_role_str());
			at_cmd_respond("OK");
			return;
		}

		int err = app_settings_set_role(val);

		at_cmd_respond(err ? "ERROR" : "OK");
		return;
	}

	/* ATS adv_autostart=? or ATS adv_autostart=<y|n> */
	if (strncasecmp(args, "adv_autostart", 13) == 0) {
		const char *val = args + 13;

		if (*val != '=') {
			at_cmd_respond("ERROR");
			return;
		}
		val++;

		if (*val == '?') {
			at_cmd_respond(app_settings_get_adv_autostart()
				       ? "y" : "n");
			at_cmd_respond("OK");
			return;
		}

		int err = app_settings_set_adv_autostart(val);

		at_cmd_respond(err ? "ERROR" : "OK");
		return;
	}

	/* ATS devicename=? or ATS devicename=<value> */
	if (strncasecmp(args, "devicename", 10) == 0) {
		const char *val = args + 10;

		if (*val != '=') {
			at_cmd_respond("ERROR");
			return;
		}
		val++;

		if (*val == '?') {
			at_cmd_respond(app_settings_get_name());
			at_cmd_respond("OK");
			return;
		}

		/* Strip optional quotes */
		size_t len = strlen(val);
		char name_buf[CONFIG_BT_DEVICE_NAME_MAX + 1];

		if (len >= 2 && val[0] == '"' && val[len - 1] == '"') {
			if (len - 2 > CONFIG_BT_DEVICE_NAME_MAX || len < 3) {
				at_cmd_respond("ERROR");
				return;
			}
			memcpy(name_buf, val + 1, len - 2);
			name_buf[len - 2] = '\0';
		} else {
			if (len > CONFIG_BT_DEVICE_NAME_MAX || len == 0) {
				at_cmd_respond("ERROR");
				return;
			}
			memcpy(name_buf, val, len);
			name_buf[len] = '\0';
		}

		int err = app_settings_set_name(name_buf);

		at_cmd_respond(err ? "ERROR" : "OK");
		return;
	}

	/* ATS baudrate=? or ATS baudrate=<num> */
	if (strncasecmp(args, "baudrate", 8) == 0) {
		const char *val = args + 8;

		if (*val != '=') {
			at_cmd_respond("ERROR");
			return;
		}
		val++;

		if (*val == '?') {
			char resp[32];

			snprintk(resp, sizeof(resp), "%u",
				 app_settings_get_baudrate());
			at_cmd_respond(resp);
			at_cmd_respond("OK");
			return;
		}

		char *end;
		unsigned long baud = strtoul(val, &end, 10);

		if (end == val || *end != '\0' || baud == 0 || baud > UINT32_MAX) {
			at_cmd_respond("ERROR");
			return;
		}

		int err = app_settings_set_baudrate((uint32_t)baud);

		if (err) {
			at_cmd_respond("ERROR");
			return;
		}

		/* Send OK at the old baudrate before switching */
		at_cmd_respond("OK");

		/* Brief delay to let the OK transmit fully */
		k_msleep(50);

		at_cmd_set_baudrate((uint32_t)baud);
		return;
	}

	/* ATS conn_int=? or ATS conn_int=<ms> */
	if (strncasecmp(args, "conn_int", 8) == 0) {
		const char *val = args + 8;

		if (*val != '=') {
			at_cmd_respond("ERROR");
			return;
		}
		val++;

		if (*val == '?') {
			char resp[32];

			snprintk(resp, sizeof(resp), "%u",
				 app_settings_get_conn_interval_ms());
			at_cmd_respond(resp);
			at_cmd_respond("OK");
			return;
		}

		char *end;
		unsigned long ms = strtoul(val, &end, 10);

		if (end == val || *end != '\0' || ms > UINT16_MAX) {
			at_cmd_respond("ERROR");
			return;
		}

		int err = app_settings_set_conn_interval_ms((uint16_t)ms);

		at_cmd_respond(err ? "ERROR" : "OK");
		return;
	}

	/* ATS autoconnect=? or ATS autoconnect=<mac>,<int_ms> or ATS autoconnect=n */
	if (strncasecmp(args, "autoconnect", 11) == 0) {
		const char *val = args + 11;

		if (*val != '=') {
			at_cmd_respond("ERROR");
			return;
		}
		val++;

		if (*val == '?') {
			const struct autoconnect_cfg *cfg =
				app_settings_get_autoconnect();

			if (cfg->enabled) {
				char resp[32];

				snprintk(resp, sizeof(resp), "%s,%u",
					 cfg->mac, cfg->interval_ms);
				at_cmd_respond(resp);
			} else {
				at_cmd_respond("n");
			}
			at_cmd_respond("OK");
			return;
		}

		if (strcasecmp(val, "n") == 0) {
			int err = app_settings_set_autoconnect_off();

			at_cmd_respond(err ? "ERROR" : "OK");
			return;
		}

		/* Parse <mac>,<int_ms> */
		const char *comma = strchr(val, ',');

		if (!comma || (comma - val) != 12) {
			at_cmd_respond("ERROR");
			return;
		}

		char mac_buf[13];

		memcpy(mac_buf, val, 12);
		mac_buf[12] = '\0';

		uint16_t interval_ms = (uint16_t)atoi(comma + 1);

		if (interval_ms == 0) {
			at_cmd_respond("ERROR");
			return;
		}

		int err = app_settings_set_autoconnect(mac_buf, interval_ms);

		at_cmd_respond(err ? "ERROR" : "OK");
		return;
	}

	at_cmd_respond("ERROR");
}

static void at_range_handler(const char *args)
{
	while (*args == ' ') {
		args++;
	}

	/* AT+RANGE mac=<addr>[,int=<ms>] */
	if (bt_mgr_get_role() != BT_MGR_ROLE_INITIATOR) {
		at_cmd_respond("ERROR");
		return;
	}

	if (strncasecmp(args, "mac=", 4) != 0) {
		at_cmd_respond("ERROR");
		return;
	}

	const char *mac_start = args + 4;
	const char *comma = strchr(mac_start, ',');
	size_t mac_len = comma ? (size_t)(comma - mac_start) : strlen(mac_start);

	if (mac_len != 12) {
		at_cmd_respond("ERROR");
		return;
	}

	char mac_str[13];

	memcpy(mac_str, mac_start, 12);
	mac_str[12] = '\0';

	uint16_t interval_ms = 1000;

	if (comma) {
		const char *int_param = comma + 1;

		while (*int_param == ' ') {
			int_param++;
		}
		if (strncasecmp(int_param, "int=", 4) != 0) {
			at_cmd_respond("ERROR");
			return;
		}
		interval_ms = (uint16_t)atoi(int_param + 4);
		if (interval_ms == 0) {
			at_cmd_respond("ERROR");
			return;
		}
	}

	bt_addr_le_t addr;
	int err = bt_mgr_scan_lookup(mac_str, &addr);

	if (err) {
		at_cmd_respond("ERROR");
		return;
	}

	/* Stop scanning if active — controller can't scan and connect */
	if (bt_mgr_is_scanning()) {
		bt_mgr_scan_stop();
	}

	uint8_t session_id;

	err = session_mgr_start(&addr, interval_ms, &session_id);
	if (err) {
		at_cmd_respond("ERROR");
		return;
	}

	char resp[16];

	snprintk(resp, sizeof(resp), "+RANGE:%u", session_id);
	at_cmd_respond(resp);
	at_cmd_respond("OK");
}

static void at_iq_handler(const char *args)
{
	while (*args == ' ') {
		args++;
	}

	if (strcasecmp(args, "on") == 0 || strcasecmp(args, "off") == 0) {
		if (!session_mgr_has_active()) {
			at_cmd_respond("ERROR");
			return;
		}
		iq_output_set_enabled(strcasecmp(args, "on") == 0);
		at_cmd_respond("OK");
	} else if (*args == '?') {
		at_cmd_respond(iq_output_is_enabled() ? "on" : "off");
		at_cmd_respond("OK");
	} else {
		at_cmd_respond("ERROR");
	}
}

static void at_diag_handler(const char *args)
{
	session_mgr_diag();
	at_cmd_respond("OK");
}

static void at_rangex_handler(const char *args)
{
	while (*args == ' ') {
		args++;
	}

	uint8_t id = (uint8_t)atoi(args);

	if (id == 0) {
		at_cmd_respond("ERROR");
		return;
	}

	int err = session_mgr_stop(id);

	if (!err) {
		autoconnect_user_stopped = true;
	}

	at_cmd_respond(err ? "ERROR" : "OK");
}

int main(void)
{
	const struct device *uart = DEVICE_DT_GET(DT_CHOSEN(zephyr_console));

	if (!device_is_ready(uart)) {
		LOG_ERR("UART device not ready");
		return -ENODEV;
	}

	at_cmd_init(uart);
	at_cmd_register("AT+ADV", at_adv_handler);
	at_cmd_register("AT+SCAN", at_scan_handler);
	at_cmd_register("AT+IQ", at_iq_handler);
	at_cmd_register("AT+DIAG", at_diag_handler);
	at_cmd_register("AT+RANGEX", at_rangex_handler);
	at_cmd_register("AT+RANGE", at_range_handler);
	at_cmd_register("ATS", ats_handler);
	at_cmd_register("ATI", ati_handler);
	at_cmd_register("ATZ", atz_handler);
	at_cmd_register("AT", at_test_handler);

	k_work_init_delayable(&autoconnect_scan_work, autoconnect_scan_work_fn);
	k_work_init(&autoconnect_connect_work, autoconnect_connect_work_fn);

	int err = bt_mgr_init();

	if (err) {
		LOG_ERR("BT init failed (err %d)", err);
		return -1;
	}

	bt_mgr_set_scan_found_cb(autoconnect_scan_found_cb);

	err = app_settings_init();
	if (err) {
		LOG_WRN("Settings init failed (err %d), using defaults", err);
	}

	/* Apply saved baudrate (default 115200 if not set) */
	uint32_t baud = app_settings_get_baudrate();

	if (baud != 115200) {
		at_cmd_set_baudrate(baud);
	}

	session_mgr_init();
	session_mgr_set_disconnect_cb(autoconnect_disconnect_cb);

	at_cmd_respond("OK");

	autoconnect_trigger();

	return 0;
}
```

## src/app_settings.c
```c
#include "app_settings.h"
#include "bt_mgr.h"

#include <string.h>
#include <strings.h>
#include <zephyr/kernel.h>
#include <zephyr/settings/settings.h>
#include <zephyr/bluetooth/bluetooth.h>
#include <zephyr/logging/log.h>

LOG_MODULE_REGISTER(app_settings, LOG_LEVEL_INF);

#define SETTINGS_KEY_NAME      "cs_at/name"
#define SETTINGS_KEY_ROLE      "cs_at/role"
#define SETTINGS_KEY_ADV_AUTO  "cs_at/advauto"
#define SETTINGS_KEY_CONN_INT  "cs_at/connint"
#define SETTINGS_KEY_BAUDRATE  "cs_at/baud"
#define SETTINGS_KEY_AUTOCONN  "cs_at/autocon"
#define NAME_MAX_LEN           CONFIG_BT_DEVICE_NAME_MAX
#define ROLE_MAX_LEN           16
#define CONN_INT_DEFAULT_MS    100
#define CONN_INT_MIN_MS        10
#define CONN_INT_MAX_MS        400
#define BAUDRATE_DEFAULT       115200

static char device_name[NAME_MAX_LEN + 1];
static bool name_loaded;

static char role_str[ROLE_MAX_LEN + 1];
static bool role_loaded;

static bool adv_autostart;
static bool adv_autostart_loaded;

static uint16_t conn_interval_ms = CONN_INT_DEFAULT_MS;
static bool conn_interval_loaded;

static uint32_t baudrate = BAUDRATE_DEFAULT;
static bool baudrate_loaded;

static struct autoconnect_cfg autoconn_cfg;
static bool autoconn_loaded;

static int settings_set_cb(const char *name, size_t len,
			   settings_read_cb read_cb, void *cb_arg)
{
	if (!strcmp(name, "name")) {
		if (len > NAME_MAX_LEN) {
			len = NAME_MAX_LEN;
		}
		int rc = read_cb(cb_arg, device_name, len);

		if (rc >= 0) {
			device_name[rc] = '\0';
			name_loaded = true;
			LOG_INF("Loaded device name: \"%s\"", device_name);
		}
		return 0;
	}

	if (!strcmp(name, "advauto")) {
		char val;

		if (len >= 1) {
			int rc = read_cb(cb_arg, &val, 1);

			if (rc >= 1) {
				adv_autostart = (val == 'y');
				adv_autostart_loaded = true;
				LOG_INF("Loaded adv_autostart: %c", val);
			}
		}
		return 0;
	}

	if (!strcmp(name, "connint")) {
		uint16_t val;

		if (len == sizeof(val)) {
			int rc = read_cb(cb_arg, &val, sizeof(val));

			if (rc == sizeof(val) &&
			    val >= CONN_INT_MIN_MS && val <= CONN_INT_MAX_MS) {
				conn_interval_ms = val;
				conn_interval_loaded = true;
				LOG_INF("Loaded conn_int: %u ms", val);
			}
		}
		return 0;
	}

	if (!strcmp(name, "baud")) {
		uint32_t val;

		if (len == sizeof(val)) {
			int rc = read_cb(cb_arg, &val, sizeof(val));

			if (rc == sizeof(val) && val > 0) {
				baudrate = val;
				baudrate_loaded = true;
				LOG_INF("Loaded baudrate: %u", val);
			}
		}
		return 0;
	}

	if (!strcmp(name, "autocon")) {
		struct autoconnect_cfg val;

		if (len == sizeof(val)) {
			int rc = read_cb(cb_arg, &val, sizeof(val));

			if (rc == sizeof(val)) {
				memcpy(&autoconn_cfg, &val, sizeof(val));
				autoconn_cfg.mac[12] = '\0';
				autoconn_loaded = true;
				LOG_INF("Loaded autoconnect: %s, %s,%u",
					val.enabled ? "on" : "off",
					val.mac, val.interval_ms);
			}
		}
		return 0;
	}

	if (!strcmp(name, "role")) {
		if (len > ROLE_MAX_LEN) {
			len = ROLE_MAX_LEN;
		}
		int rc = read_cb(cb_arg, role_str, len);

		if (rc >= 0) {
			role_str[rc] = '\0';
			role_loaded = true;
			LOG_INF("Loaded role: \"%s\"", role_str);
		}
		return 0;
	}

	return -ENOENT;
}

SETTINGS_STATIC_HANDLER_DEFINE(cs_at, "cs_at", NULL, settings_set_cb, NULL, NULL);

int app_settings_init(void)
{
	int err = settings_subsys_init();

	if (err) {
		LOG_ERR("settings_subsys_init failed (err %d)", err);
		return err;
	}

	err = settings_load();
	if (err) {
		LOG_ERR("settings_load failed (err %d)", err);
		return err;
	}

	if (!name_loaded) {
		strncpy(device_name, CONFIG_BT_DEVICE_NAME, NAME_MAX_LEN);
		device_name[NAME_MAX_LEN] = '\0';
	}

	/* Apply the name to the BT stack */
	err = bt_set_name(device_name);
	if (err) {
		LOG_ERR("bt_set_name failed (err %d)", err);
		return err;
	}

	/* Apply the saved role */
	if (!role_loaded) {
		strncpy(role_str, "none", ROLE_MAX_LEN);
	}

	enum bt_mgr_role role = BT_MGR_ROLE_NONE;

	if (strcasecmp(role_str, "initiator") == 0) {
		role = BT_MGR_ROLE_INITIATOR;
	} else if (strcasecmp(role_str, "reflector") == 0) {
		role = BT_MGR_ROLE_REFLECTOR;
	}

	bt_mgr_set_role(role);

	/* Auto-start advertising if configured and role is reflector */
	if (adv_autostart && role == BT_MGR_ROLE_REFLECTOR) {
		int adv_err = bt_mgr_adv_start();

		if (adv_err) {
			LOG_WRN("Adv autostart failed (err %d)", adv_err);
		} else {
			LOG_INF("Adv autostart: advertising started");
		}
	}

	return 0;
}

const char *app_settings_get_name(void)
{
	return device_name;
}

int app_settings_set_name(const char *name)
{
	size_t len = strlen(name);

	if (len == 0 || len > NAME_MAX_LEN) {
		return -EINVAL;
	}

	strncpy(device_name, name, NAME_MAX_LEN);
	device_name[NAME_MAX_LEN] = '\0';

	int err = bt_set_name(device_name);

	if (err) {
		LOG_ERR("bt_set_name failed (err %d)", err);
		return err;
	}

	err = settings_save_one(SETTINGS_KEY_NAME, device_name, strlen(device_name));
	if (err) {
		LOG_ERR("settings_save_one failed (err %d)", err);
		return err;
	}

	LOG_INF("Device name set to \"%s\"", device_name);
	return 0;
}

static enum bt_mgr_role parse_role(const char *str)
{
	if (strcasecmp(str, "initiator") == 0) {
		return BT_MGR_ROLE_INITIATOR;
	} else if (strcasecmp(str, "reflector") == 0) {
		return BT_MGR_ROLE_REFLECTOR;
	} else if (strcasecmp(str, "none") == 0) {
		return BT_MGR_ROLE_NONE;
	}
	return -1;
}

static const char *role_to_str(enum bt_mgr_role role)
{
	switch (role) {
	case BT_MGR_ROLE_INITIATOR:
		return "initiator";
	case BT_MGR_ROLE_REFLECTOR:
		return "reflector";
	default:
		return "none";
	}
}

const char *app_settings_get_role_str(void)
{
	return role_to_str(bt_mgr_get_role());
}

int app_settings_set_role(const char *str)
{
	int role = parse_role(str);

	if (role == -1) {
		return -EINVAL;
	}

	int err = bt_mgr_set_role(role);

	if (err) {
		return err;
	}

	const char *canonical = role_to_str(role);

	strncpy(role_str, canonical, ROLE_MAX_LEN);

	err = settings_save_one(SETTINGS_KEY_ROLE, canonical, strlen(canonical));
	if (err) {
		LOG_ERR("settings_save_one failed (err %d)", err);
		return err;
	}

	LOG_INF("Role set to \"%s\"", canonical);
	return 0;
}

bool app_settings_get_adv_autostart(void)
{
	return adv_autostart;
}

int app_settings_set_adv_autostart(const char *val)
{
	if (strcasecmp(val, "y") == 0) {
		adv_autostart = true;
	} else if (strcasecmp(val, "n") == 0) {
		adv_autostart = false;
	} else {
		return -EINVAL;
	}

	char c = adv_autostart ? 'y' : 'n';
	int err = settings_save_one(SETTINGS_KEY_ADV_AUTO, &c, 1);

	if (err) {
		LOG_ERR("settings_save_one failed (err %d)", err);
		return err;
	}

	LOG_INF("adv_autostart set to %c", c);
	return 0;
}

uint16_t app_settings_get_conn_interval_ms(void)
{
	return conn_interval_ms;
}

int app_settings_set_conn_interval_ms(uint16_t ms)
{
	if (ms < CONN_INT_MIN_MS || ms > CONN_INT_MAX_MS) {
		return -EINVAL;
	}

	conn_interval_ms = ms;

	int err = settings_save_one(SETTINGS_KEY_CONN_INT, &ms, sizeof(ms));

	if (err) {
		LOG_ERR("settings_save_one failed (err %d)", err);
		return err;
	}

	LOG_INF("conn_int set to %u ms", ms);
	return 0;
}

static const uint32_t supported_baudrates[] = {
	9600, 19200, 38400, 57600, 115200, 230400, 460800, 921600,
};

uint32_t app_settings_get_baudrate(void)
{
	return baudrate;
}

int app_settings_set_baudrate(uint32_t baud)
{
	bool valid = false;

	for (size_t i = 0; i < ARRAY_SIZE(supported_baudrates); i++) {
		if (baud == supported_baudrates[i]) {
			valid = true;
			break;
		}
	}

	if (!valid) {
		return -EINVAL;
	}

	baudrate = baud;

	int err = settings_save_one(SETTINGS_KEY_BAUDRATE, &baud, sizeof(baud));

	if (err) {
		LOG_ERR("settings_save_one failed (err %d)", err);
		return err;
	}

	LOG_INF("baudrate set to %u", baud);
	return 0;
}

const struct autoconnect_cfg *app_settings_get_autoconnect(void)
{
	return &autoconn_cfg;
}

static bool is_hex_string(const char *s, size_t len)
{
	for (size_t i = 0; i < len; i++) {
		char c = s[i];

		if (!((c >= '0' && c <= '9') ||
		      (c >= 'A' && c <= 'F') ||
		      (c >= 'a' && c <= 'f'))) {
			return false;
		}
	}
	return true;
}

int app_settings_set_autoconnect(const char *mac, uint16_t interval_ms)
{
	if (strlen(mac) != 12 || !is_hex_string(mac, 12)) {
		return -EINVAL;
	}

	if (interval_ms == 0) {
		return -EINVAL;
	}

	/* Store MAC as uppercase for consistent display/comparison */
	for (int i = 0; i < 12; i++) {
		char c = mac[i];

		if (c >= 'a' && c <= 'f') {
			c -= 32;
		}
		autoconn_cfg.mac[i] = c;
	}
	autoconn_cfg.mac[12] = '\0';
	autoconn_cfg.interval_ms = interval_ms;
	autoconn_cfg.enabled = true;

	int err = settings_save_one(SETTINGS_KEY_AUTOCONN,
				    &autoconn_cfg, sizeof(autoconn_cfg));

	if (err) {
		LOG_ERR("settings_save_one failed (err %d)", err);
		return err;
	}

	LOG_INF("autoconnect set to %s,%u", autoconn_cfg.mac,
		autoconn_cfg.interval_ms);
	return 0;
}

int app_settings_set_autoconnect_off(void)
{
	autoconn_cfg.enabled = false;
	memset(autoconn_cfg.mac, 0, sizeof(autoconn_cfg.mac));
	autoconn_cfg.interval_ms = 0;

	int err = settings_save_one(SETTINGS_KEY_AUTOCONN,
				    &autoconn_cfg, sizeof(autoconn_cfg));

	if (err) {
		LOG_ERR("settings_save_one failed (err %d)", err);
		return err;
	}

	LOG_INF("autoconnect disabled");
	return 0;
}
```

## src/app_settings.h
```c
#ifndef APP_SETTINGS_H_
#define APP_SETTINGS_H_

#include <stdbool.h>
#include <stdint.h>

/**
 * Initialize app settings (loads from NVS).
 * Call after bt_enable() so bt_set_name() works.
 */
int app_settings_init(void);

/**
 * Get the current device name.
 */
const char *app_settings_get_name(void);

/**
 * Set and persist the device name.
 * Takes effect on next AT+ADV start.
 * Returns 0 on success.
 */
int app_settings_set_name(const char *name);

/**
 * Get the current role as a string ("none", "initiator", "reflector").
 */
const char *app_settings_get_role_str(void);

/**
 * Set and persist the role by string.
 * Also calls bt_mgr_set_role() to apply immediately.
 * Returns 0 on success, -EINVAL for unknown role string,
 * or -EBUSY if role change is not allowed right now.
 */
int app_settings_set_role(const char *role_str);

/** Get adv_autostart setting. */
bool app_settings_get_adv_autostart(void);

/** Set and persist adv_autostart ("y" or "n"). */
int app_settings_set_adv_autostart(const char *val);

/** Get connection interval in ms. */
uint16_t app_settings_get_conn_interval_ms(void);

/** Set and persist connection interval in ms (10-400). */
int app_settings_set_conn_interval_ms(uint16_t ms);

/** Get the current baudrate. */
uint32_t app_settings_get_baudrate(void);

/**
 * Set and persist the UART baudrate.
 * Does NOT reconfigure the UART — caller is responsible for that.
 * Returns 0 on success, -EINVAL for unsupported rate.
 */
int app_settings_set_baudrate(uint32_t baud);

/** Autoconnect configuration. */
struct autoconnect_cfg {
	char mac[13];         /* 12-char hex MAC + NUL */
	uint16_t interval_ms;
	bool enabled;
};

/** Get autoconnect config. */
const struct autoconnect_cfg *app_settings_get_autoconnect(void);

/** Set and persist autoconnect (mac = 12-char hex, interval_ms > 0). */
int app_settings_set_autoconnect(const char *mac, uint16_t interval_ms);

/** Disable and persist autoconnect. */
int app_settings_set_autoconnect_off(void);

#endif /* APP_SETTINGS_H_ */
```

## src/at_cmd.c
```c
#include "at_cmd.h"

#include <string.h>
#include <strings.h>
#include <ctype.h>
#include <zephyr/kernel.h>
#include <zephyr/drivers/uart.h>
#include <zephyr/logging/log.h>

LOG_MODULE_REGISTER(at_cmd, LOG_LEVEL_INF);

#define AT_CMD_MAX_LEN     256
#define AT_CMD_QUEUE_DEPTH 4
#define AT_CMD_MAX_CMDS    16

struct at_cmd_entry {
	const char *cmd;
	at_cmd_handler_t handler;
};

static const struct device *at_uart;
static struct at_cmd_entry cmd_table[AT_CMD_MAX_CMDS];
static int cmd_count;

/* Line buffer filled in ISR context */
static char rx_buf[AT_CMD_MAX_LEN];
static int rx_pos;

/* Message queue to pass complete lines to the processing thread */
K_MSGQ_DEFINE(at_cmd_msgq, AT_CMD_MAX_LEN, AT_CMD_QUEUE_DEPTH, 1);

#define AT_CMD_THREAD_STACK_SIZE 2048
#define AT_CMD_THREAD_PRIORITY   7
static K_THREAD_STACK_DEFINE(at_cmd_stack, AT_CMD_THREAD_STACK_SIZE);
static struct k_thread at_cmd_thread_data;

void at_cmd_register(const char *cmd, at_cmd_handler_t handler)
{
	if (cmd_count >= AT_CMD_MAX_CMDS) {
		LOG_ERR("AT command table full");
		return;
	}
	cmd_table[cmd_count].cmd = cmd;
	cmd_table[cmd_count].handler = handler;
	cmd_count++;
}

void at_cmd_respond(const char *response)
{
	for (const char *p = response; *p; p++) {
		uart_poll_out(at_uart, *p);
	}
	uart_poll_out(at_uart, '\r');
	uart_poll_out(at_uart, '\n');
}

static void dispatch(char *line)
{
	/* Strip leading/trailing whitespace */
	while (*line == ' ' || *line == '\t') {
		line++;
	}
	size_t len = strlen(line);
	while (len > 0 && (line[len - 1] == ' ' || line[len - 1] == '\t')) {
		line[--len] = '\0';
	}

	if (len == 0) {
		return;
	}

	LOG_DBG("AT cmd: \"%s\"", line);

	/* Try registered commands, longest prefix match first.
	 * Commands are checked in registration order; register more specific ones first
	 * or we rely on prefix length comparison.
	 */
	int best_idx = -1;
	size_t best_len = 0;

	for (int i = 0; i < cmd_count; i++) {
		size_t cmd_len = strlen(cmd_table[i].cmd);

		if (cmd_len > len) {
			continue;
		}
		if (strncasecmp(line, cmd_table[i].cmd, cmd_len) != 0) {
			continue;
		}
		/* For exact "AT" match, ensure no alphanumeric follows (avoid matching "AT+..." with "AT") */
		if (cmd_len == 2 && len > 2 && (isalpha((unsigned char)line[2]) || line[2] == '+')) {
			continue;
		}
		if (cmd_len > best_len) {
			best_len = cmd_len;
			best_idx = i;
		}
	}

	if (best_idx >= 0) {
		const char *args = line + best_len;
		cmd_table[best_idx].handler(args);
	} else {
		at_cmd_respond("ERROR");
	}
}

static void at_cmd_thread(void *p1, void *p2, void *p3)
{
	char line[AT_CMD_MAX_LEN];

	while (true) {
		k_msgq_get(&at_cmd_msgq, line, K_FOREVER);
		dispatch(line);
	}
}

static void uart_isr(const struct device *dev, void *user_data)
{
	ARG_UNUSED(user_data);

	while (uart_irq_update(dev) && uart_irq_is_pending(dev)) {
		if (!uart_irq_rx_ready(dev)) {
			continue;
		}

		uint8_t c;
		int ret = uart_fifo_read(dev, &c, 1);

		if (ret != 1) {
			continue;
		}

		if (c == '\r' || c == '\n') {
			if (rx_pos > 0) {
				rx_buf[rx_pos] = '\0';
				k_msgq_put(&at_cmd_msgq, rx_buf, K_NO_WAIT);
				rx_pos = 0;
			}
		} else if (rx_pos < AT_CMD_MAX_LEN - 1) {
			rx_buf[rx_pos++] = c;
		}
	}
}

void at_cmd_init(const struct device *uart_dev)
{
	at_uart = uart_dev;

	uart_irq_callback_set(uart_dev, uart_isr);
	uart_irq_rx_enable(uart_dev);

	k_thread_create(&at_cmd_thread_data, at_cmd_stack,
			K_THREAD_STACK_SIZEOF(at_cmd_stack),
			at_cmd_thread, NULL, NULL, NULL,
			AT_CMD_THREAD_PRIORITY, 0, K_NO_WAIT);
	k_thread_name_set(&at_cmd_thread_data, "at_cmd");

	LOG_INF("AT command interface ready");
}

int at_cmd_set_baudrate(uint32_t baud)
{
	struct uart_config cfg;
	int err = uart_config_get(at_uart, &cfg);

	if (err) {
		return err;
	}

	cfg.baudrate = baud;

	uart_irq_rx_disable(at_uart);
	err = uart_configure(at_uart, &cfg);
	uart_irq_rx_enable(at_uart);

	if (err) {
		LOG_ERR("uart_configure failed (err %d)", err);
	}

	return err;
}
```

## src/at_cmd.h
```c
#ifndef AT_CMD_H_
#define AT_CMD_H_

#include <zephyr/device.h>

typedef void (*at_cmd_handler_t)(const char *args);

/**
 * Register an AT command handler.
 *
 * @param cmd     Command prefix to match (e.g. "AT+ROLE"). Case-insensitive.
 *                Use "AT" alone for the bare AT test command.
 * @param handler Callback invoked with everything after the prefix as args.
 *                For "AT+ROLE=INITIATOR" with prefix "AT+ROLE", args is "=INITIATOR".
 */
void at_cmd_register(const char *cmd, at_cmd_handler_t handler);

/**
 * Send a response string over the AT UART, terminated with \r\n.
 */
void at_cmd_respond(const char *response);

/**
 * Initialize the AT command interface on the given UART.
 * Starts the processing thread internally.
 */
void at_cmd_init(const struct device *uart_dev);

/**
 * Reconfigure the AT UART to a new baudrate.
 * Returns 0 on success.
 */
int at_cmd_set_baudrate(uint32_t baud);

#endif /* AT_CMD_H_ */
```

## src/bt_mgr.c
```c
#include "bt_mgr.h"
#include "at_cmd.h"
#include "app_settings.h"
#include "session_mgr.h"

#include <ctype.h>
#include <stdlib.h>
#include <zephyr/kernel.h>
#include <zephyr/bluetooth/bluetooth.h>
#include <zephyr/bluetooth/conn.h>
#include <zephyr/bluetooth/cs.h>
#include <zephyr/bluetooth/uuid.h>
#include <bluetooth/scan.h>
#include <bluetooth/services/ras.h>
#include <zephyr/logging/log.h>

LOG_MODULE_REGISTER(bt_mgr, LOG_LEVEL_INF);

static enum bt_mgr_role current_role;
static bool advertising;
static bool scanning;
static struct bt_conn *connection;
static uint8_t remote_num_antennas;

/* Reflector CS setup */
static K_SEM_DEFINE(sem_reflector_config, 0, 1);

#define REFLECTOR_SETUP_STACK_SIZE 2048
#define REFLECTOR_SETUP_PRIORITY   7
static K_THREAD_STACK_DEFINE(reflector_setup_stack, REFLECTOR_SETUP_STACK_SIZE);
static struct k_thread reflector_setup_thread_data;

/* Track already-reported scan results to avoid duplicates */
#define SCAN_MAX_DEVICES 32

static bt_addr_le_t scan_seen[SCAN_MAX_DEVICES];
static int scan_seen_count;

static struct k_work_delayable scan_timeout_work;
static bt_mgr_scan_found_cb_t scan_found_cb;

static struct bt_data ad[] = {
	BT_DATA_BYTES(BT_DATA_FLAGS, (BT_LE_AD_GENERAL | BT_LE_AD_NO_BREDR)),
	BT_DATA_BYTES(BT_DATA_UUID16_ALL, BT_UUID_16_ENCODE(BT_UUID_RANGING_SERVICE_VAL)),
	BT_DATA(BT_DATA_NAME_COMPLETE, "", 0), /* filled at adv start */
};

/* --- Antenna configuration selection --- */

static enum bt_conn_le_cs_tone_antenna_config_selection
select_tone_antenna_config(uint8_t a_antennas, uint8_t b_antennas)
{
	if (a_antennas >= 2 && b_antennas >= 2) {
		return BT_LE_CS_TONE_ANTENNA_CONFIGURATION_A2_B2;
	}

	if (a_antennas == 1) {
		switch (b_antennas) {
		case 4:  return BT_LE_CS_TONE_ANTENNA_CONFIGURATION_A1_B4;
		case 3:  return BT_LE_CS_TONE_ANTENNA_CONFIGURATION_A1_B3;
		case 2:  return BT_LE_CS_TONE_ANTENNA_CONFIGURATION_A1_B2;
		default: return BT_LE_CS_TONE_ANTENNA_CONFIGURATION_A1_B1;
		}
	}

	switch (a_antennas) {
	case 4:  return BT_LE_CS_TONE_ANTENNA_CONFIGURATION_A4_B1;
	case 3:  return BT_LE_CS_TONE_ANTENNA_CONFIGURATION_A3_B1;
	case 2:  return BT_LE_CS_TONE_ANTENNA_CONFIGURATION_A2_B1;
	default: return BT_LE_CS_TONE_ANTENNA_CONFIGURATION_A1_B1;
	}
}

static uint8_t preferred_peer_antenna_mask(uint8_t peer_antennas)
{
	uint8_t mask = 0;

	for (uint8_t i = 0; i < peer_antennas && i < 4; i++) {
		mask |= BIT(i);
	}

	return mask;
}

/* --- Reflector CS setup --- */

static void reflector_setup_thread(void *p1, void *p2, void *p3)
{
	ARG_UNUSED(p1);
	ARG_UNUSED(p2);
	ARG_UNUSED(p3);

	const struct bt_le_cs_set_default_settings_param default_settings = {
		.enable_initiator_role = false,
		.enable_reflector_role = true,
		.cs_sync_antenna_selection =
			BT_LE_CS_ANTENNA_SELECTION_OPT_REPETITIVE,
		.max_tx_power = BT_HCI_OP_LE_CS_MAX_MAX_TX_POWER,
	};

	int err = bt_le_cs_set_default_settings(connection, &default_settings);

	if (err) {
		LOG_ERR("Reflector CS default settings failed (err %d)", err);
		at_cmd_respond("+REFLECTOR ERROR");
		return;
	}

	LOG_INF("Reflector: waiting for CS config from initiator...");

	/* Wait for initiator to create CS config */
	if (k_sem_take(&sem_reflector_config, K_SECONDS(30)) != 0) {
		LOG_WRN("Reflector: CS config timeout");
		at_cmd_respond("+REFLECTOR TIMEOUT");
		return;
	}

	if (!connection) {
		return;
	}

	/* Set procedure parameters (wide range — initiator's values take precedence) */
	uint8_t peer_antennas = MAX(1, remote_num_antennas);
	uint8_t local_antennas = CONFIG_BT_CTLR_SDC_CS_NUM_ANTENNAS;

	const struct bt_le_cs_set_procedure_parameters_param proc_params = {
		.config_id = 0,
		.max_procedure_len = 1000,
		.min_procedure_interval = 1,
		.max_procedure_interval = 100,
		.max_procedure_count = 0,
		.min_subevent_len = 10000,
		.max_subevent_len = 75000,
		.tone_antenna_config_selection =
			select_tone_antenna_config(peer_antennas, local_antennas),
		.phy = BT_LE_CS_PROCEDURE_PHY_2M,
		.tx_power_delta = 0x80,
		.preferred_peer_antenna =
			preferred_peer_antenna_mask(peer_antennas),
		.snr_control_initiator = BT_LE_CS_SNR_CONTROL_NOT_USED,
		.snr_control_reflector = BT_LE_CS_SNR_CONTROL_NOT_USED,
	};

	err = bt_le_cs_set_procedure_parameters(connection, &proc_params);
	if (err) {
		LOG_ERR("Reflector procedure params failed (err %d)", err);
		at_cmd_respond("+REFLECTOR ERROR");
		return;
	}

	LOG_INF("Reflector: CS setup complete, ready for ranging");
	at_cmd_respond("+REFLECTOR READY");
}

/* --- CS callbacks (reflector role) --- */

static void config_create_cb(struct bt_conn *conn, uint8_t status,
			     struct bt_conn_le_cs_config *config)
{
	/* Only handle for reflector connections */
	if (conn != connection || current_role != BT_MGR_ROLE_REFLECTOR) {
		return;
	}

	if (status == BT_HCI_ERR_SUCCESS) {
		LOG_INF("Reflector: CS config created (id %u)", config->id);
		k_sem_give(&sem_reflector_config);
	} else {
		LOG_WRN("Reflector: CS config failed (0x%02x)", status);
	}
}

static void security_enable_cb(struct bt_conn *conn, uint8_t status)
{
	if (conn != connection || current_role != BT_MGR_ROLE_REFLECTOR) {
		return;
	}

	if (status == BT_HCI_ERR_SUCCESS) {
		LOG_INF("Reflector: CS security enabled");
	} else {
		LOG_WRN("Reflector: CS security failed (0x%02x)", status);
	}
}

static void procedure_enable_cb(struct bt_conn *conn, uint8_t status,
				struct bt_conn_le_cs_procedure_enable_complete *params)
{
	if (conn != connection || current_role != BT_MGR_ROLE_REFLECTOR) {
		return;
	}

	if (status == BT_HCI_ERR_SUCCESS && params->state == 1) {
		LOG_INF("Reflector: CS procedures enabled (interval %u)",
			params->procedure_interval);
	} else if (status == BT_HCI_ERR_SUCCESS && params->state == 0) {
		LOG_INF("Reflector: CS procedures disabled");
	} else {
		LOG_WRN("Reflector: procedure enable failed (0x%02x)", status);
	}
}

static void remote_capabilities_cb(struct bt_conn *conn, uint8_t status,
				   struct bt_conn_le_cs_capabilities *params)
{
	if (conn != connection || current_role != BT_MGR_ROLE_REFLECTOR) {
		return;
	}

	if (status == BT_HCI_ERR_SUCCESS) {
		remote_num_antennas = params->num_antennas_supported;
		LOG_INF("Reflector: CS capability exchange completed, "
			"remote has %u antenna(s)", params->num_antennas_supported);
	} else {
		LOG_WRN("Reflector: CS capability exchange failed (0x%02x)", status);
	}
}

/* --- Connection callbacks --- */

static void connected_cb(struct bt_conn *conn, uint8_t err)
{
	if (session_mgr_owns_conn(conn)) {
		return;
	}

	if (err) {
		LOG_WRN("Connection failed (err %u)", err);
		at_cmd_respond("+CONNECT FAIL");
		return;
	}

	connection = bt_conn_ref(conn);
	advertising = false;

	char addr_str[BT_ADDR_LE_STR_LEN];

	bt_addr_le_to_str(bt_conn_get_dst(conn), addr_str, sizeof(addr_str));
	LOG_INF("Connected: %s", addr_str);
	at_cmd_respond("+CONNECTED");

	/* If we're in reflector role, start CS setup */
	if (current_role == BT_MGR_ROLE_REFLECTOR) {
		k_sem_reset(&sem_reflector_config);
		k_thread_create(&reflector_setup_thread_data,
				reflector_setup_stack,
				K_THREAD_STACK_SIZEOF(reflector_setup_stack),
				reflector_setup_thread, NULL, NULL, NULL,
				REFLECTOR_SETUP_PRIORITY, 0, K_NO_WAIT);
		k_thread_name_set(&reflector_setup_thread_data,
				  "refl_setup");
	}
}

static void disconnected_cb(struct bt_conn *conn, uint8_t reason)
{
	if (session_mgr_owns_conn(conn)) {
		return;
	}

	LOG_INF("Disconnected (reason 0x%02x)", reason);

	/* Unblock reflector setup thread if waiting */
	k_sem_give(&sem_reflector_config);

	if (connection) {
		bt_conn_unref(connection);
		connection = NULL;
	}
	remote_num_antennas = 0;

	at_cmd_respond("+DISCONNECTED");

	/* Auto-restart advertising if configured */
	if (current_role == BT_MGR_ROLE_REFLECTOR &&
	    app_settings_get_adv_autostart()) {
		int adv_err = bt_mgr_adv_start();

		if (adv_err) {
			LOG_WRN("Adv autostart failed (err %d)", adv_err);
		}
	}
}

BT_CONN_CB_DEFINE(conn_cbs) = {
	.connected = connected_cb,
	.disconnected = disconnected_cb,
	.le_cs_read_remote_capabilities_complete = remote_capabilities_cb,
	.le_cs_config_complete = config_create_cb,
	.le_cs_security_enable_complete = security_enable_cb,
	.le_cs_procedure_enable_complete = procedure_enable_cb,
};

int bt_mgr_init(void)
{
	int err = bt_enable(NULL);

	if (err) {
		LOG_ERR("bt_enable failed (err %d)", err);
		return err;
	}

	LOG_INF("Bluetooth initialized");
	return 0;
}

int bt_mgr_set_role(enum bt_mgr_role role)
{
	if (connection) {
		LOG_WRN("Cannot change role while connected");
		return -EBUSY;
	}

	if (advertising) {
		LOG_WRN("Stop advertising before changing role");
		return -EBUSY;
	}

	if (scanning) {
		LOG_WRN("Stop scanning before changing role");
		return -EBUSY;
	}

	current_role = role;
	return 0;
}

enum bt_mgr_role bt_mgr_get_role(void)
{
	return current_role;
}

int bt_mgr_adv_start(void)
{
	if (current_role != BT_MGR_ROLE_REFLECTOR) {
		LOG_WRN("Advertising requires reflector role");
		return -EINVAL;
	}

	if (advertising) {
		return -EALREADY;
	}

	if (connection) {
		return -EBUSY;
	}

	/* Update ad data with current device name */
	const char *name = app_settings_get_name();

	ad[2].data = name;
	ad[2].data_len = strlen(name);

	int err = bt_le_adv_start(BT_LE_ADV_CONN_FAST_2, ad, ARRAY_SIZE(ad), NULL, 0);

	if (err) {
		LOG_ERR("bt_le_adv_start failed (err %d)", err);
		return err;
	}

	advertising = true;
	LOG_INF("Advertising as \"%s\"", name);
	return 0;
}

int bt_mgr_adv_stop(void)
{
	if (!advertising) {
		return 0;
	}

	int err = bt_le_adv_stop();

	if (err) {
		LOG_ERR("bt_le_adv_stop failed (err %d)", err);
		return err;
	}

	advertising = false;
	LOG_INF("Advertising stopped");
	return 0;
}

bool bt_mgr_is_advertising(void)
{
	return advertising;
}

/* --- Scanning --- */

static bool scan_already_seen(const bt_addr_le_t *addr)
{
	for (int i = 0; i < scan_seen_count; i++) {
		if (bt_addr_le_cmp(&scan_seen[i], addr) == 0) {
			return true;
		}
	}
	return false;
}

static void scan_filter_match(struct bt_scan_device_info *device_info,
			      struct bt_scan_filter_match *filter_match,
			      bool connectable)
{
	if (!scanning) {
		return;
	}

	const bt_addr_le_t *addr = device_info->recv_info->addr;

	if (scan_already_seen(addr)) {
		return;
	}

	if (scan_seen_count < SCAN_MAX_DEVICES) {
		bt_addr_le_copy(&scan_seen[scan_seen_count++], addr);
	}

	/* Extract device name from advertisement data if present */
	const char *name = NULL;
	uint8_t name_len = 0;
	struct net_buf_simple *ad = device_info->adv_data;
	struct net_buf_simple_state state;

	net_buf_simple_save(ad, &state);

	while (ad->len > 1) {
		uint8_t len = net_buf_simple_pull_u8(ad);
		uint8_t type;

		if (len == 0 || len > ad->len) {
			break;
		}

		type = net_buf_simple_pull_u8(ad);
		if (type == BT_DATA_NAME_COMPLETE || type == BT_DATA_NAME_SHORTENED) {
			name = (const char *)ad->data;
			name_len = len - 1;
			break;
		}
		net_buf_simple_pull(ad, len - 1);
	}

	net_buf_simple_restore(ad, &state);

	const uint8_t *a = addr->a.val;
	char resp[64];

	if (name && name_len > 0) {
		int off = snprintk(resp, sizeof(resp),
				   "+SCAN:%02X%02X%02X%02X%02X%02X,%d,",
				   a[5], a[4], a[3], a[2], a[1], a[0],
				   device_info->recv_info->rssi);
		uint8_t copy_len = MIN(name_len, sizeof(resp) - off - 1);

		memcpy(resp + off, name, copy_len);
		resp[off + copy_len] = '\0';
	} else {
		snprintk(resp, sizeof(resp), "+SCAN:%02X%02X%02X%02X%02X%02X,%d",
			 a[5], a[4], a[3], a[2], a[1], a[0],
			 device_info->recv_info->rssi);
	}
	at_cmd_respond(resp);

	if (scan_found_cb) {
		char mac_hex[13];

		snprintk(mac_hex, sizeof(mac_hex),
			 "%02X%02X%02X%02X%02X%02X",
			 a[5], a[4], a[3], a[2], a[1], a[0]);
		scan_found_cb(mac_hex);
	}
}

BT_SCAN_CB_INIT(scan_cb, scan_filter_match, NULL, NULL, NULL);

static void scan_timeout_handler(struct k_work *work)
{
	bt_mgr_scan_stop();
}

static int scan_module_init(void)
{
	static bool initialized;

	if (initialized) {
		return 0;
	}

	struct bt_scan_init_param param = {
		.connect_if_match = 0,
	};

	bt_scan_init(&param);
	bt_scan_cb_register(&scan_cb);

	int err = bt_scan_filter_add(BT_SCAN_FILTER_TYPE_UUID,
				     BT_UUID_RANGING_SERVICE);
	if (err) {
		LOG_ERR("Scan filter add failed (err %d)", err);
		return err;
	}

	err = bt_scan_filter_enable(BT_SCAN_UUID_FILTER, false);
	if (err) {
		LOG_ERR("Scan filter enable failed (err %d)", err);
		return err;
	}

	k_work_init_delayable(&scan_timeout_work, scan_timeout_handler);
	initialized = true;
	return 0;
}

int bt_mgr_scan_start(uint16_t timeout_sec)
{
	if (current_role != BT_MGR_ROLE_INITIATOR) {
		LOG_WRN("Scanning requires initiator role");
		return -EINVAL;
	}

	if (scanning) {
		return -EALREADY;
	}

	int err = scan_module_init();

	if (err) {
		return err;
	}

	scan_seen_count = 0;

	err = bt_scan_start(BT_SCAN_TYPE_SCAN_PASSIVE);
	if (err) {
		LOG_ERR("bt_scan_start failed (err %d)", err);
		return err;
	}

	scanning = true;
	LOG_INF("Scanning started");

	if (timeout_sec > 0) {
		k_work_schedule(&scan_timeout_work, K_SECONDS(timeout_sec));
	}

	return 0;
}

int bt_mgr_scan_stop(void)
{
	if (!scanning) {
		return 0;
	}

	k_work_cancel_delayable(&scan_timeout_work);

	int err = bt_scan_stop();

	if (err) {
		LOG_ERR("bt_scan_stop failed (err %d)", err);
		return err;
	}

	scanning = false;
	LOG_INF("Scanning stopped");
	at_cmd_respond("+SCANDONE");
	return 0;
}

bool bt_mgr_is_scanning(void)
{
	return scanning;
}

/* --- Address Lookup --- */

static int parse_hex_mac(const char *hex, bt_addr_t *addr)
{
	if (strlen(hex) != 12) {
		return -EINVAL;
	}

	for (int i = 0; i < 6; i++) {
		char hi = hex[i * 2];
		char lo = hex[i * 2 + 1];

		if (!isxdigit((unsigned char)hi) || !isxdigit((unsigned char)lo)) {
			return -EINVAL;
		}

		char byte_str[3] = {hi, lo, '\0'};
		/* BLE addresses are stored LSB first */
		addr->val[5 - i] = (uint8_t)strtoul(byte_str, NULL, 16);
	}

	return 0;
}

int bt_mgr_scan_lookup(const char *mac_hex, bt_addr_le_t *addr)
{
	bt_addr_t parsed;
	int err = parse_hex_mac(mac_hex, &parsed);

	if (err) {
		return err;
	}

	/* Search scan results for matching address to get correct type */
	for (int i = 0; i < scan_seen_count; i++) {
		if (bt_addr_cmp(&scan_seen[i].a, &parsed) == 0) {
			bt_addr_le_copy(addr, &scan_seen[i]);
			return 0;
		}
	}

	/* Not found in scan results — assume random address */
	addr->type = BT_ADDR_LE_RANDOM;
	bt_addr_copy(&addr->a, &parsed);
	return 0;
}

void bt_mgr_set_scan_found_cb(bt_mgr_scan_found_cb_t cb)
{
	scan_found_cb = cb;
}
```

## src/bt_mgr.h
```c
#ifndef BT_MGR_H_
#define BT_MGR_H_

#include <stdbool.h>
#include <stdint.h>
#include <zephyr/bluetooth/addr.h>

enum bt_mgr_role {
	BT_MGR_ROLE_NONE,
	BT_MGR_ROLE_INITIATOR,
	BT_MGR_ROLE_REFLECTOR,
};

/**
 * Initialize the Bluetooth stack.
 * Returns 0 on success, negative errno on failure.
 */
int bt_mgr_init(void);

/**
 * Set the device role (initiator or reflector).
 * This only stores the role internally — it does not start
 * advertising or scanning.
 * Returns 0 on success, negative errno on failure.
 */
int bt_mgr_set_role(enum bt_mgr_role role);

/** Get the current role. */
enum bt_mgr_role bt_mgr_get_role(void);

/**
 * Start advertising with the RAS UUID (reflector role).
 * Returns -EINVAL if role is not reflector, -EALREADY if already
 * advertising, or a BT error code.
 */
int bt_mgr_adv_start(void);

/**
 * Stop advertising.
 * Returns 0 on success or if not advertising.
 */
int bt_mgr_adv_stop(void);

/** Returns true if currently advertising. */
bool bt_mgr_is_advertising(void);

/**
 * Start scanning for devices advertising the RAS UUID.
 * Each new device found is reported as "+SCAN:<addr>,<rssi>".
 * Scanning stops after timeout_sec seconds, or runs indefinitely
 * if timeout_sec is 0. Sends "+SCANDONE" when finished.
 * Returns -EINVAL if role is not initiator.
 */
int bt_mgr_scan_start(uint16_t timeout_sec);

/**
 * Stop an ongoing scan.
 * Returns 0 on success or if not scanning.
 */
int bt_mgr_scan_stop(void);

/** Returns true if currently scanning. */
bool bt_mgr_is_scanning(void);

/**
 * Look up a scanned device address by MAC hex string (e.g. "AABBCCDDEEFF").
 * Returns the full bt_addr_le_t with correct address type from scan results.
 * If not found, fills addr with the parsed MAC and BT_ADDR_LE_RANDOM type.
 * Returns 0 on success, -EINVAL if MAC string is malformed.
 */
int bt_mgr_scan_lookup(const char *mac_hex, bt_addr_le_t *addr);

/** Callback type invoked for each new scan result. mac_hex is 12-char uppercase. */
typedef void (*bt_mgr_scan_found_cb_t)(const char *mac_hex);

/** Register a callback invoked for each new scan result. */
void bt_mgr_set_scan_found_cb(bt_mgr_scan_found_cb_t cb);

#endif /* BT_MGR_H_ */
```

## src/iq_output.h
```c
#ifndef IQ_OUTPUT_H_
#define IQ_OUTPUT_H_

#include <stdint.h>
#include <stdbool.h>

#define IQ_NUM_CHANNELS 75
#define IQ_MAX_ANTENNA_PATHS CONFIG_BT_RAS_MAX_ANTENNA_PATHS

/* Per-tone validity mask: 1 bit per tone, packed LSB-first.
 * Tone n lives in bit (n % 8) of byte (n / 8). 10 bytes covers 80 bits >= 75.
 */
#define IQ_VALID_MASK_BYTES 10

/* Per-tone quality: 2 bits per tone, packed LSB-first.
 * Tone n lives in bits ((n % 4) * 2) of byte (n / 4). 19 bytes covers 76 tones.
 * Values match BT_HCI_LE_CS_TONE_QUALITY_*: 0=HIGH, 1=MED, 2=LOW, 3=UNAVAILABLE.
 */
#define IQ_TONE_QUALITY_BYTES 19

struct iq_antenna_path {
	int16_t i_local[IQ_NUM_CHANNELS];
	int16_t q_local[IQ_NUM_CHANNELS];
	int16_t i_remote[IQ_NUM_CHANNELS];
	int16_t q_remote[IQ_NUM_CHANNELS];
	uint8_t valid_mask[IQ_VALID_MASK_BYTES];
	uint8_t tone_quality[IQ_TONE_QUALITY_BYTES];
	bool quality_ok;
};

/* Sentinel value for freq_compensation when not available (matches HCI). */
#define IQ_FREQ_COMP_NA ((int16_t)0xC000)

struct iq_report {
	struct iq_antenna_path ap[IQ_MAX_ANTENNA_PATHS];
	uint8_t n_ap;
	int32_t rtt_half_ns;
	uint8_t rtt_count;
	int16_t freq_compensation; /* 0.01 ppm units, IQ_FREQ_COMP_NA if absent */
};

void iq_output_set_enabled(bool enabled);
bool iq_output_is_enabled(void);

/**
 * Queue IQ tone data for output over the AT interface.
 * Called from BLE callbacks — returns immediately.
 *
 * @param session_id  Session ID for the output prefix.
 * @param report      Populated IQ report.
 */
void iq_output_report(uint8_t session_id, const struct iq_report *report);

#endif /* IQ_OUTPUT_H_ */
```

## src/version.h
```c
#ifndef VERSION_H_
#define VERSION_H_

#define APP_VERSION "0.9"
#define APP_BUILD_NAME "cs_at_command"

#endif /* VERSION_H_ */
```
