## build_bl54l15_dvk/Kconfig/boards/Kconfig.sysbuild
```kconfig
# Load Sysbuild board Kconfig descriptions.
osource "/opt/nordic/ncs/v3.2.4/zephyr/boards/ezurio/bl54l15_dvk/Kconfig.sysbuild"
```

## build_bl54l15_dvk/cs_at_command/Kconfig/boards/Kconfig.defconfig
```kconfig
# Load Zephyr board defconfig descriptions.
osource "/opt/nordic/ncs/v3.2.4/zephyr/boards/ezurio/bl54l15_dvk/Kconfig.defconfig"
```

## build_bl54l15u_dvk_dual-antenna/BT-Channel-Sounding-AT-Command/Kconfig/arch/Kconfig
```kconfig
# Load Zephyr Arch Kconfig descriptions.
osource "/opt/nordic/ncs/v3.2.4/zephyr/arch/rx/Kconfig"
osource "/opt/nordic/ncs/v3.2.4/zephyr/arch/x86/Kconfig"
osource "/opt/nordic/ncs/v3.2.4/zephyr/arch/xtensa/Kconfig"
osource "/opt/nordic/ncs/v3.2.4/zephyr/arch/sparc/Kconfig"
osource "/opt/nordic/ncs/v3.2.4/zephyr/arch/riscv/Kconfig"
osource "/opt/nordic/ncs/v3.2.4/zephyr/arch/posix/Kconfig"
osource "/opt/nordic/ncs/v3.2.4/zephyr/arch/mips/Kconfig"
osource "/opt/nordic/ncs/v3.2.4/zephyr/arch/arm64/Kconfig"
osource "/opt/nordic/ncs/v3.2.4/zephyr/arch/arm/Kconfig"
osource "/opt/nordic/ncs/v3.2.4/zephyr/arch/arc/Kconfig"
```
